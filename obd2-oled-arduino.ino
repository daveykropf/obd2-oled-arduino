/*********************************************************************
  Golf MK6 CANBUS OLED DISPLAY

  - Created by Davey Kropf
*********************************************************************/

#include <Canbus.h>
#include <SPI.h>
#include <Wire.h>
#include <Adafruit_GFX.h>
#include <Adafruit_SSD1306.h>
#include <Fonts/FreeSansBold12pt7b.h>
#include <Fonts/FreeSansBold18pt7b.h>

#define OLED_RESET 4
Adafruit_SSD1306 display(OLED_RESET);

#if (SSD1306_LCDHEIGHT != 32)
#error("Height incorrect, please fix Adafruit_SSD1306.h!");
#endif

// 'Volkswagen', 64x32px
const unsigned char startupBitmap [] PROGMEM = {
  0x00, 0x00, 0x00, 0x00, 0x00, 0x00, 0x00, 0x00, 0x00, 0x00, 0x00, 0x00, 0x00, 0x00, 0x00, 0x00,
  0x00, 0x00, 0x00, 0x00, 0x00, 0x00, 0x00, 0x00, 0x00, 0x00, 0x00, 0x00, 0x00, 0x00, 0x00, 0x00,
  0x00, 0x00, 0x00, 0x0f, 0xf0, 0x00, 0x00, 0x00, 0x00, 0x00, 0x00, 0x3f, 0xfc, 0x00, 0x00, 0x00,
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  0x00, 0x00, 0x00, 0x00, 0x00, 0x00, 0x00, 0x00, 0x00, 0x00, 0x00, 0x00, 0x00, 0x00, 0x00, 0x00
};

// 'sleep-icon', 64x32px
const unsigned char standbyBitmap [] PROGMEM = {
  0x00, 0x00, 0x00, 0x00, 0x00, 0x00, 0x00, 0x00, 0x00, 0x00, 0x00, 0x00, 0x00, 0x00, 0x00, 0x00,
  0x00, 0x00, 0x00, 0x00, 0x00, 0x00, 0x00, 0x00, 0x00, 0x00, 0x0f, 0xff, 0xff, 0xf0, 0x00, 0x00,
  0x00, 0x00, 0x1f, 0xff, 0xff, 0xf8, 0x00, 0x00, 0x00, 0x00, 0x18, 0x00, 0x00, 0x18, 0x00, 0x00,
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  0x00, 0x00, 0x00, 0x00, 0x00, 0x00, 0x00, 0x00, 0x00, 0x00, 0x00, 0x00, 0x00, 0x00, 0x00, 0x00
};

const unsigned char batteryBitmap [] PROGMEM = {
  0x00, 0x00, 0x00, 0x00, 0x00, 0x00, 0x00, 0x00, 0x00, 0x00, 0x00, 0x00, 0x00, 0x00, 0x00, 0x00,
  0x00, 0x00, 0x00, 0x00, 0x00, 0x00, 0x00, 0x00, 0x00, 0x00, 0x0f, 0x80, 0x00, 0xf8, 0x00, 0x00,
  0x00, 0x00, 0x1f, 0x80, 0x01, 0xf8, 0x00, 0x00, 0x00, 0x00, 0x1f, 0x80, 0x01, 0xf8, 0x00, 0x00,
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  0x00, 0x00, 0x00, 0x00, 0x00, 0x00, 0x00, 0x00, 0x00, 0x00, 0x00, 0x00, 0x00, 0x00, 0x00, 0x00
};

const unsigned char oilBitmap [] PROGMEM = {
  0x00, 0x00, 0x00, 0x00, 0x00, 0x00, 0x00, 0x00, 0x00, 0x00, 0x00, 0x00, 0x00, 0x00, 0x00, 0x00,
  0x00, 0x00, 0x00, 0x00, 0x00, 0x00, 0x00, 0x00, 0x00, 0x00, 0x00, 0x00, 0x00, 0x00, 0x00, 0x00,
  0x00, 0x00, 0x00, 0x00, 0x00, 0x00, 0x00, 0x00, 0x00, 0x00, 0x00, 0x00, 0x00, 0x00, 0x00, 0x00,
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  0x00, 0x00, 0x00, 0x00, 0x00, 0x00, 0x00, 0x00, 0x00, 0x00, 0x00, 0x00, 0x00, 0x00, 0x00, 0x00
};

// 'engine-rpm', 64x32px
const unsigned char engineRPMBitmap [] PROGMEM = {
  0x00, 0x00, 0x00, 0x00, 0x00, 0x00, 0x00, 0x00, 0x00, 0x00, 0x00, 0x00, 0x00, 0x00, 0x00, 0x00,
  0x00, 0x00, 0x00, 0x00, 0x00, 0x00, 0x00, 0x00, 0x00, 0x00, 0x00, 0x00, 0x00, 0x00, 0x00, 0x00,
  0x00, 0x00, 0x00, 0x0f, 0xf0, 0x00, 0x00, 0x00, 0x00, 0x00, 0x00, 0x3f, 0xfc, 0x00, 0x00, 0x00,
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  0x00, 0x00, 0x00, 0x00, 0x00, 0x00, 0x00, 0x00, 0x00, 0x00, 0x00, 0x00, 0x00, 0x00, 0x00, 0x00
};
// 'engine-coolant', 64x32px
const unsigned char engineCoolantBitmap [] PROGMEM = {
  0x00, 0x00, 0x00, 0x00, 0x00, 0x00, 0x00, 0x00, 0x00, 0x00, 0x00, 0x00, 0x00, 0x00, 0x00, 0x00,
  0x00, 0x00, 0x00, 0x01, 0x80, 0x00, 0x00, 0x00, 0x00, 0x00, 0x00, 0x01, 0x80, 0x00, 0x00, 0x00,
  0x00, 0x00, 0x00, 0x01, 0x80, 0x00, 0x00, 0x00, 0x00, 0x00, 0x00, 0x01, 0xfc, 0x00, 0x00, 0x00,
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  0x00, 0x00, 0x00, 0x00, 0x00, 0x00, 0x00, 0x00, 0x00, 0x00, 0x00, 0x00, 0x00, 0x00, 0x00, 0x00
};
// 'intake-temp', 64x32px
const unsigned char intakeTempBitmap [] PROGMEM = {
  0x00, 0x00, 0x00, 0x00, 0x00, 0x00, 0x00, 0x00, 0x00, 0x00, 0x00, 0x00, 0x00, 0x00, 0x00, 0x00,
  0x00, 0x00, 0x00, 0x00, 0x00, 0x00, 0x00, 0x00, 0x00, 0x00, 0x00, 0x00, 0x00, 0x00, 0x00, 0x00,
  0x00, 0x00, 0x00, 0x00, 0x00, 0x80, 0x00, 0x00, 0x00, 0x00, 0x00, 0x1c, 0x01, 0xc0, 0x00, 0x00,
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  0x00, 0x00, 0x00, 0x00, 0x00, 0x00, 0x00, 0x00, 0x00, 0x00, 0x00, 0x00, 0x00, 0x00, 0x00, 0x00
};

// constants won't change. They're used here to set pin numbers:
const int buttonPin = 5;

// Variables will change:
int totalObdModusOptions = 5;
int currentObdModus = 0;
int lastModusBeforeSleep = 0;
int buttonState;
int lastButtonState = HIGH;
int inStandbyModus = false;

bool shouldShowIcon = true;
bool isShowingIcon = false;
unsigned long timeToShowIcon = 1000;

// the following variables are unsigned longs because the time, measured in
// milliseconds, will quickly become a bigger number than can be stored in an int.
unsigned long lastDebounceTime = 0;
unsigned long debounceDelay = 50;
unsigned long previousMillis = 0;
unsigned long previousLastCheckResponseMillis = 0;

const long updateDataIntervalShort = 50;
const long updateDataIntervalLong = 500;
const long updateDataIntervalStandby = 2000;
const long checkForLastResponseInterval = 1000;

char buffer[456];  // Canbus data will be temporarily stored to this buffer before being outputted to the display

void setup()   {
  Serial.begin(9600);

  pinMode(buttonPin, INPUT_PULLUP);

  display.begin(SSD1306_SWITCHCAPVCC, 0x3C);
  display.clearDisplay();

  Serial.println("Golf MK6 CANBUS DISPLAY");

  showStartupLogo();

  if (Canbus.init(CANSPEED_500)) /* Initialise MCP2515 CAN controller at the specified speed */
  {
    Serial.println("CAN Init ok");
    showCanbusInitResponse(true);
  } else
  {
    Serial.println("Can't init CAN");
    showCanbusInitResponse(false);
  }

  delay(1000);
  resetValues(millis());
}


void loop() {
  unsigned long currentMillis = millis();

  // milis van response opslaan
  // Als laatste response ouder is dan 4 seconden, dan standby aan.
  // In standby de channel ENGINE_RUNTIME checken. Bij response, standby weer uit.

  checkForButtonChanges(currentMillis);
  checkForStandbyMode(currentMillis);

  if (shouldShowIcon) {
    showIcon(currentMillis);
  } else {
    updateData(currentMillis);
  }

  checkForLastResponse(currentMillis);
}

void checkForButtonChanges(unsigned long currentMillis) {
  int reading = digitalRead(buttonPin);

  if (reading != lastButtonState) {
    lastDebounceTime = currentMillis;
  }

  if ((currentMillis - lastDebounceTime) > debounceDelay) {
    if (reading != buttonState) {
      buttonState = reading;

      if (buttonState == LOW) {
        currentObdModus++;
        if (currentObdModus > (totalObdModusOptions - 1)) {
          currentObdModus = 0;
        }
        resetValues(currentMillis);
      }
    }
  }

  lastButtonState = reading;
}

void checkForStandbyMode(unsigned long currentMillis) {
  if (currentObdModus == 4 && !shouldShowIcon && !inStandbyModus) {
    inStandbyModus = true;
    sleepDisplay();
  } else if (currentObdModus != 4 && inStandbyModus) {
    inStandbyModus = false;
    wakeDisplay();
    showStartupLogo();
    resetValues(millis());
  }
}

void showStartupLogo() {
  display.clearDisplay();
  display.drawBitmap(0, 0, startupBitmap, 64, 32, WHITE);
  display.display();
  delay(2000);
}

void resetValues(unsigned long currentMillis) {
  shouldShowIcon = true;
  isShowingIcon = false;
  previousMillis = currentMillis;
  memset(buffer, 0, sizeof(buffer));
}

void showIcon(unsigned long currentMillis) {
  if (!isShowingIcon) {
    isShowingIcon = true;
    display.clearDisplay();
    switch (currentObdModus) {
      case 0: // ECU_VOLTAGE
        display.drawBitmap(0, 0, batteryBitmap, 64, 32, WHITE);
        break;
      case 1: // ENGINE_COOLANT_TEMP
        display.drawBitmap(0, 0, engineCoolantBitmap, 64, 32, WHITE);
        break;
      case 2: // INTAKE_TEMP
        display.drawBitmap(0, 0, intakeTempBitmap, 64, 32, WHITE);
        break;
      case 3: // ENGINE_RPM
        display.drawBitmap(0, 0, engineRPMBitmap, 64, 32, WHITE);
        break;
      case 4: // STANDBY
        display.drawBitmap(0, 0, standbyBitmap, 64, 32, WHITE);
        break;
    }
    display.display();
  }

  if ((currentMillis - previousMillis) > timeToShowIcon) {
    shouldShowIcon = false;
    isShowingIcon = false;
  }
}

void updateData(unsigned long currentMillis) {
  long currentUpdateDataInterval;
  if (currentObdModus == 3) {
    currentUpdateDataInterval = updateDataIntervalShort;
  } else if (currentObdModus == 4) {
    currentUpdateDataInterval = updateDataIntervalStandby;
  } else {
    currentUpdateDataInterval = updateDataIntervalLong;
  }

  if (currentMillis - previousMillis >= currentUpdateDataInterval) {
    switch (currentObdModus) {
      case 0: // ECU_VOLTAGE
        Canbus.ecu_req(ECU_VOLTAGE, buffer);
        showVoltage(buffer);
        break;
      case 1: // ENGINE_COOLANT_TEMP
        Canbus.ecu_req(ENGINE_COOLANT_TEMP, buffer);
        showTemperature(buffer);
        break;
      case 2: // INTAKE_TEMP
        Canbus.ecu_req(INTAKE_TEMP, buffer);
        showTemperature(buffer);
        break;
      case 3: // ENGINE_RPM
        Canbus.ecu_req(ENGINE_RPM, buffer);
        showEngineRPM(buffer);
        break;
      case 4: // ENGINE_RUNTIME
        Canbus.ecu_req(ENGINE_RUNTIME, buffer);
        break;
    }

    previousMillis = currentMillis;
  }
}

void checkForLastResponse(unsigned long currentMillis) {
  if (currentMillis - previousLastCheckResponseMillis >= checkForLastResponseInterval) {
    unsigned long lastResponse = Canbus.last_response();
    unsigned long diff = currentMillis - lastResponse;

    if (diff > 5000 && !inStandbyModus && currentObdModus != 4) {
      lastModusBeforeSleep = currentObdModus;
      currentObdModus = 4;
      resetValues(currentMillis);
    }

    if (diff < 2000 && currentObdModus == 4 && inStandbyModus) {
      currentObdModus = lastModusBeforeSleep;
      resetValues(currentMillis);
    }

    previousLastCheckResponseMillis = currentMillis;
  }
}

void showVoltage(char voltage[]) {
  if (strlen(voltage) == 0 || voltage == "") return;

  display.clearDisplay();
  display.setFont(&FreeSansBold12pt7b);
  display.setTextSize(1);
  display.setTextColor(WHITE);
  display.setCursor(6, 24);
  display.print(voltage);
  display.setCursor(54, 24);
  display.setFont();
  display.setTextSize(1);
  display.println("v");
  display.display();
}

void showTemperature(char temperature[]) {
  if (strlen(temperature) == 0 || temperature == "") return;

  display.clearDisplay();
  if (strlen(temperature) < 3) {
    display.setFont(&FreeSansBold18pt7b);
    display.setTextSize(1);
    display.setTextColor(WHITE);
    display.setCursor(6, 28);
    display.print(temperature);
    display.setCursor(48, 13);
  } else {
    display.setFont(&FreeSansBold12pt7b);
    display.setTextSize(1);
    display.setTextColor(WHITE);
    display.setCursor(6, 24);
    display.print(temperature);
    display.setCursor(48, 15);
  }
  display.setFont();
  display.setTextSize(1);
  display.print((char)247);
  display.println("C");
  display.display();
}

void showEngineRPM(char rpm[]) {
  if (strlen(rpm) == 0 || rpm == "") return;

  display.clearDisplay();
  display.setFont(&FreeSansBold12pt7b);
  display.setTextSize(1);
  display.setTextColor(WHITE);

  if (strlen(rpm) < 2) {
    display.setCursor(26, 19);
  } else if (strlen(rpm) < 4) {
    display.setCursor(12, 19);
  } else {
    display.setCursor(6, 19);
  }
  display.print(rpm);

  display.setFont();
  display.setTextSize(1);
  display.setCursor(24, 23);
  display.println("rpm");
  display.display();
}

void showCanbusInitResponse(bool success) {
  display.clearDisplay();
  display.setFont(&FreeSansBold12pt7b);
  display.setTextSize(1);
  display.setTextColor(WHITE);
  if (success) {
    display.setCursor(14, 24);
    display.print("OK");
  } else {
    display.setCursor(6, 24);
    display.print("FAIL");
  }
  display.display();
}

void sleepDisplay() {
  display.ssd1306_command(SSD1306_DISPLAYOFF);
}

void wakeDisplay() {
  display.ssd1306_command(SSD1306_DISPLAYON);
}
